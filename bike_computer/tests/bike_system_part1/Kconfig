## bike_computer/tests/bike_system_part1/Kconfig
```kconfig
# SPDX-License-Identifier: Apache-2.0
# Copyright (c) 2022 Meta

module = APP
module-str = APP
source "subsys/logging/Kconfig.template.log_config"

rsource "../../Kconfig"

config TEST_DURATION_IN_MS
  int "Test duration in milliseconds"
  depends on TEST
  default 120000
  help 
    This option allows to specify the test duration in milliseconds for a successful test run. 
    The value can be overridden for each platform in the testcase.yaml file. 
    The value should be set so that the test passes on your platform. It should not be below 20000 for any platform.
```

## bike_computer/tests/bike_system_part1/testcase.yaml
```yaml
tests:
  bike_computer.bike_system_part1:
    tags:
      - bike_computer
      - phase_a
    timeout: 150
    extra_configs:
      - platform:qemu_x86/atom:CONFIG_TEST_DURATION_IN_MS=120000
      - platform:nrf5340dk/nrf5340/cpuapp:CONFIG_TEST_DURATION_IN_MS=22000
    extra_conf_files: 
      - ../../../deps/zpp_lib/configs/prj.conf
      - ../../../deps/zpp_lib/configs/prj_gpio.conf
      - ../../../deps/zpp_lib/configs/prj_sensor.conf
      - ../../../deps/zpp_lib/configs/prj_display.conf
      - ../../../deps/zpp_lib/configs/prj_test.conf
      - ../../../deps/zpp_lib/configs/prj_phase_a.conf
    extra_args: 
      - platform:qemu_x86/atom:CONFIG_INTERRUPT_IN_EMUL=y
      - platform:qemu_x86/atom:CONFIG_EMUL=y
      - platform:qemu_x86/atom:CONFIG_SYS_CLOCK_TICKS_PER_SEC=5000
      - platform:qemu_x86/atom:DTC_OVERLAY_FILE=../../../deps/zpp_lib/configs/boards/qemu_x86.overlay
      - platform:nrf5340dk/nrf5340/cpuapp:SHIELD=adafruit_2_8_tft_touch_v2
      - platform:nrf5340dk/nrf5340/cpuapp:DTC_OVERLAY_FILE=../../../deps/zpp_lib/configs/boards/nrf5340dk_nrf5340_cpuapp.overlay
```

## bike_computer/tests/sensor_device/testcase.yaml
```yaml
tests:
  bike_computer.sensor_device:
    tags:
      - bike_computer
      - phase_a
    extra_conf_files: 
      - ../../../deps/zpp_lib/configs/prj.conf
      - ../../../deps/zpp_lib/configs/prj_log.conf
      - ../../../deps/zpp_lib/configs/prj_debug.conf
      - ../../../deps/zpp_lib/configs/prj_sensor.conf
      - ../../../deps/zpp_lib/configs/prj_test.conf    
    extra_args: 
      - platform:qemu_x86/atom:CONFIG_INTERRUPT_IN_EMUL=y
      - platform:qemu_x86/atom:CONFIG_EMUL=y
      - platform:qemu_x86/atom:CONFIG_SYS_CLOCK_TICKS_PER_SEC=5000
      - platform:qemu_x86/atom:DTC_OVERLAY_FILE=../../../deps/zpp_lib/configs/boards/qemu_x86.overlay
      - platform:nrf5340dk/nrf5340/cpuapp:DTC_OVERLAY_FILE=../../../deps/zpp_lib/configs/boards/nrf5340dk_nrf5340_cpuapp.overlay
```

## blinky/boards/qemu_x86.conf
```kconfig
# Enable the emulation framework
CONFIG_EMUL=y
CONFIG_GPIO_EMUL=y
CONFIG_I2C_EMUL=y
```

## car_system/tests/task_recorder/testcase.yaml
```yaml
tests:
  car_system.task_recorder:
    tags:
      - car_system
      - phase_a
    extra_configs:
      - CONFIG_PERIOD_OFFSET_TOLERANCE=700
      - CONFIG_COMPUTATION_TIME_OFFSET_TOLERANCE=300
  car_system.task_recorder_user_mode:
    tags:
      - car_system
      - phase_a_user_mode
    extra_configs:
      - CONFIG_PERIOD_OFFSET_TOLERANCE=700
      - CONFIG_COMPUTATION_TIME_OFFSET_TOLERANCE=300
      - CONFIG_TEST_USERSPACE=y
      - CONFIG_ZPP_SEMAPHORE_POOL_SIZE=4

      
```

## car_system/tests/timing/testcase.yaml
```yaml
tests:
  car_system.timing.phase_a:
    timeout: 300
    tags:
      - car_system
      - phase_a
    extra_configs:
      - CONFIG_PERIODIC_TASKS=y
  car_system.timing.phase_b:
    timeout: 300
    tags:
      - car_system
      - phase_b
    extra_configs:
      - CONFIG_PERIODIC_TASKS=y
      - CONFIG_APERIODIC_TASKS=y
      - CONFIG_COMPUTATION_TIME_OFFSET_TOLERANCE=800
  car_system.timing.phase_c:
    timeout: 300
    tags:
      - car_system
      - phase_c
    extra_configs:      
      - CONFIG_PERIODIC_TASKS=y
      - CONFIG_TASK_DEPENDENCIES=y
      - CONFIG_COMPUTATION_TIME_OFFSET_TOLERANCE=500
  car_system.timing.phase_a_user_mode:
    timeout: 300
    tags:
      - car_system
    extra_configs:
      - CONFIG_PERIODIC_TASKS=y
      - CONFIG_USERSPACE=y
      - CONFIG_LOG_MODE_MINIMAL=y      
```

## multi_tasking/Kconfig
```kconfig
menu "Zephyr"
source "Kconfig.zephyr"
endmenu

module = APP
module-str = APP
source "subsys/logging/Kconfig.template.log_config"

config WORK_ON_BUTTON_SLEEP
  bool "Let the processing thread perform sleep rather than busy wait"
  default n
  help
    This option must be enabled to let the processing thread sleep
    rather than busy waiting

config WORK_ON_BUTTON_USE_WORK_QUEUE
  bool "Let the ISR defer work to another thread"
  default n
  help
    This option must be enabled to let the ISR defer work
    and not attempt to perform processing and enter a critical section

config WAIT_ON_BUTTON_THREAD_PRIORITY
  int "Define the priority of the WaitOnButton thread"
  default 9
  help
    This option defines the priority at which the WaitOnButton
    must execute. The default value corresponds to 
    PreemptableThreadPriority::PriorityNormal which is
    CONFIG_NUM_PREEMPT_PRIORITIES - 6

config WAIT_ON_BUTTON_SLEEP
  bool "Let the main thread perform sleep rather than busy wait"
  default n
  help
    This option must be enabled to let the main thread sleep
    rather than busy waiting

config DISPLAY_CURRENT_TIME_WAIT
  bool "Let the display thread perform a wait while updating current time"
  default n
  help
    This option must be enabled to let the display thread wait and 
    thus be suspended in the middle of an update

config CURRENT_TIME_MUTEX
  bool "Add a mutex to protect _current_time from concurrent accesses"
  default n
  help
    This option must be enabled to add a mutex to protect _current_time
    from concurrent accesses

config BUFFER_USE_MUTEX_AND_SEMAPHORE
  bool "Use a mutex and semaphores for a correct buffer implementation"
  default n
  help
    This option must be enabled to implement the Buffer class correctly
    with the use of a mutex and semaphores
```

## simple_tests/always_succeed/testcase.yaml
```yaml
tests:
  simple_tests.always_succeed:
    tags:
      - cpp
    extra_conf_files: 
      - ../../deps/zpp_lib/configs/prj.conf
      - ../../deps/zpp_lib/configs/prj_log.conf
      - ../../deps/zpp_lib/configs/prj_debug.conf
      - ../../deps/zpp_lib/configs/prj_test.conf
      
```

## simple_tests/tests/always_succeed/testcase.yaml
```yaml
tests:
  simple_tests.always_succeed:
    tags:
      - cpp
    extra_conf_files: ["prj_test.conf"]
      
```
